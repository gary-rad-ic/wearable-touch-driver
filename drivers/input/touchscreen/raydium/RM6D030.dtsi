&i2c_5 {
	raydium_ts@39 {
		compatible = "raydium,raydium-ts";
		reg = <0x39>;
		interrupt-parent = <&msm_gpio>;
		interrupts = <13 0x2008>;
		vdd_ana-supply = <&pm8916_l17>;
		vcc_i2c-supply = <&pm8916_l6>;
		pinctrl-names = "pmx_ts_active","pmx_ts_suspend","pmx_ts_release";
		pinctrl-0 = <&ts_int_active &ts_reset_active>;
		pinctrl-1 = <&ts_int_suspend &ts_reset_suspend>;
		pinctrl-2 = <&ts_release>;
		raydium,reset-gpio = <&msm_gpio 12 0x00>;
		raydium,irq-gpio = <&msm_gpio 13 0x00>;
		raydium,num-max-touches = <2>;
		raydium,soft-reset-delay-ms = <50>;
		raydium,hard-reset-delay-ms = <100>;
		raydium,x_max = <320>;
		raydium,y_max = <360>;
		raydium,display-coords= <0 0 320 360>; /*temp*/
	};
};